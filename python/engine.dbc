VERSION ""

NS_ :

BS_:

BU_: ECU ABS

BO_ 256 EngineData: 8 ECU
 SG_ EngineRPM : 0|16@1+ (0.25,0) [0|16000] "rpm" ABS
 SG_ EngineTemp : 16|8@1+ (1,-40) [-40|215] "degC" ABS
